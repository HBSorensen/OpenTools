## Software/yocto/meta-opentools/conf/distro/opentools.conf
```bitbake
# OpenTools distro: a slim, appliance-focused derivative of Poky.
#
# Goal: smallest sensible footprint that still runs a Qt6 GUI directly on the
# GPU (eglfs/KMS) with no X11 or Wayland display server.

require conf/distro/poky.conf

DISTRO = "opentools"
DISTRO_NAME = "OpenTools Linux"
DISTRO_VERSION = "1.0"
DISTRO_CODENAME = "gsender"
MAINTAINER = "OpenTools <hbsn@foss.dk>"
SDK_VENDOR = "-opentoolssdk"

# systemd as init (needed for the kiosk service, udev automount, mount units).
INIT_MANAGER = "systemd"

# Trim features we never use on this appliance. Crucially: no x11/wayland
# (Qt renders straight to KMS/DRM via eglfs), and add opengl so Mesa builds the
# vc4 GLESv2 driver that eglfs needs on the Pi.
DISTRO_FEATURES:remove = "x11 wayland vulkan bluetooth nfc 3g zeroconf pcmcia pci-x irda pulseaudio"
DISTRO_FEATURES:append = " opengl"

# Don't drag in locale bloat.
IMAGE_LINGUAS = ""
ENABLE_BINARY_LOCALE_GENERATION = "0"

# Prefer runtime-lean choices.
VIRTUAL-RUNTIME_init_manager = "systemd"
VIRTUAL-RUNTIME_dev_manager = "systemd"

# We build our own tiny image; no need for the reference distro's extras.
DISTRO_FEATURES_BACKFILL_CONSIDERED += "pulseaudio"
```

## Software/yocto/meta-opentools/conf/layer.conf
```bitbake
# meta-opentools layer configuration

BBPATH .= ":${LAYERDIR}"

BBFILES += "${LAYERDIR}/recipes-*/*/*.bb \
            ${LAYERDIR}/recipes-*/*/*.bbappend"

BBFILE_COLLECTIONS += "opentools"
BBFILE_PATTERN_opentools = "^${LAYERDIR}/"
BBFILE_PRIORITY_opentools = "10"

LAYERDEPENDS_opentools = "core raspberrypi qt6-layer"
LAYERSERIES_COMPAT_opentools = "scarthgap"

# Custom partition layout (read-only rootfs + writable /data) lives here.
WKS_SEARCH_PATH .= ":${LAYERDIR}/wic"
```

## Software/yocto/meta-opentools/conf/machine/include/opentools-rpi.inc
```bitbake
# Machine tuning for the OpenTools appliance on a Raspberry Pi 3.
#
# Included from the kas local_conf_header so it applies on top of the stock
# `raspberrypi3` machine without forking a whole machine definition.

# --- Display: official Raspberry Pi 7" DSI panel (800x480) via full KMS -------
# vc4-kms-v3d       : full KMS driver -> Mesa vc4 GLESv2 (what Qt eglfs uses)
# vc4-kms-dsi-7inch : the official 7" panel + edt-ft5406 capacitive touch
#
# NOTE: if the panel comes up black with the backlight off (a known KMS-DSI
# quirk in some builds), switch BOTH lines to the fake-KMS variants:
#     dtoverlay=vc4-fkms-v3d
#     dtoverlay=vc4-fkms-dsi-7inch
# Never mix kms and fkms. See Software/docs/BUILD.md.
RPI_EXTRA_CONFIG:append = '\n\
# --- OpenTools display ---\n\
dtoverlay=vc4-kms-v3d\n\
dtoverlay=vc4-kms-dsi-7inch\n\
disable_overscan=1\n\
# Quiet, fast boot for an appliance\n\
disable_splash=1\n\
boot_delay=0\n\
'

# We talk to grblHAL over USB (CDC-ACM), not the GPIO UART. Leaving the UART
# off keeps the PL011 free and shaves a little boot time.
ENABLE_UART = "0"

# Quiet kernel console for a clean appliance boot.
CMDLINE:append = " quiet logo.nologo vt.global_cursor_default=0"

# Custom partitioning: boot + read-only rootfs + writable /data.
WKS_FILE = "opentools-rpi.wks"
```

## Software/yocto/meta-opentools/wic/opentools-rpi.wks
```
# OpenTools SD-card layout for the Raspberry Pi 3.
#
#   p1  /boot   vfat   RPi firmware + kernel + dtb + overlays  (bootimg-partition)
#   p2  /       ext4   root filesystem, mounted READ-ONLY at runtime
#   p3  /data   ext4   small writable partition: settings + saved .nc files
#
# External USB sticks are auto-mounted under /run/media at runtime (tmpfs), so
# the read-only rootfs is never touched by user data.

part /boot --source bootimg-partition --ondisk mmcblk0 --fstype=vfat --label boot --active --align 4096 --size 100M
part /     --source rootfs            --ondisk mmcblk0 --fstype=ext4 --label root --align 4096
part /data                            --ondisk mmcblk0 --fstype=ext4 --label data --align 4096 --size 64M --fsoptions "defaults,noatime"

bootloader --ptable msdos
```
